## config/west.yml
```yaml
manifest:
  remotes:
    - name: zmkfirmware
      url-base: https://github.com/zmkfirmware
    - name: flyer2001
      url-base: https://github.com/flyer2001/zmk.git
  projects:
    - name: zmk
      remote: flyer2001
      revision: main
      import: app/west.yml
  self:
    path: config
```
